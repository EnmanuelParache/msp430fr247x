# MSP430FR2475 register map
Vendor: msp430gen; File version: v0.4.0-28-gb0087ce-dirty
Registers are 16-bit, read-write, reset 0x0 unless marked. A register's access mark holds for its fields unless they carry their own. Offsets are from the block's base; [hi:lo] are bit positions.

## P3
Base 0x00000220
0x00 P3IN 8-bit — Port 3 Input
0x02 P3OUT 8-bit — Port 3 Output
0x04 P3DIR 8-bit — Port 3 Direction
0x06 P3REN 8-bit — Port 3 Resistor Enable
0x0A P3SEL0 8-bit — Port 3 Select 0
0x0C P3SEL1 8-bit — Port 3 Select 1
0x0E P3IV — Port 3 Interrupt Vector Register
  [15:0] P3IV ro — Port 3 interrupt vector value
    0=NONE (No interrupt pending); 2=IFG0 (Interrupt Source: Port x.0 interrupt; Interrupt Flag: PxIFG.0; Interrupt Priority: Highest); 4=IFG1 (Interrupt Source: Port x.1 interrupt; Interrupt Flag: PxIFG.1); 6=IFG2 (Interrupt Source: Port x.2 interrupt; Interrupt Flag: PxIFG.2); 8=IFG3 (Interrupt Source: Port x.3 interrupt; Interrupt Flag: PxIFG.3); 10=IFG4 (Interrupt Source: Port x.4 interrupt; Interrupt Flag: PxIFG.4); 12=IFG5 (Interrupt Source: Port x.5 interrupt; Interrupt Flag: PxIFG.5); 14=IFG6 (Interrupt Source: Port x.6 interrupt; Interrupt Flag: PxIFG.6); 16=IFG7 (Interrupt Source: Port x.7 interrupt; Interrupt Flag: PxIFG.7; Interrupt Priority: Lowest)
0x16 P3SELC 8-bit — Port 3 Complement Select
0x18 P3IES 8-bit — Port 3 Interrupt Edge Select
0x1A P3IE 8-bit — Port 3 Interrupt Enable
0x1C P3IFG 8-bit — Port 3 Interrupt Flag

## P4
Base 0x00000220
0x01 P4IN 8-bit — Port 4 Input
0x03 P4OUT 8-bit — Port 4 Output
0x05 P4DIR 8-bit — Port 4 Direction
0x07 P4REN 8-bit — Port 4 Resistor Enable
0x0B P4SEL0 8-bit — Port 4 Select 0
0x0D P4SEL1 8-bit — Port 4 Select 1
0x17 P4SELC 8-bit — Port 4 Complement Select
0x19 P4IES 8-bit — Port 4 Interrupt Edge Select
0x1B P4IE 8-bit — Port 4 Interrupt Enable
0x1D P4IFG 8-bit — Port 4 Interrupt Flag
0x1E P4IV — Port 4 Interrupt Vector Register
  [15:0] P4IV ro — Port 4 interrupt vector value
    0=NONE (No interrupt pending); 2=IFG0 (Interrupt Source: Port x.0 interrupt; Interrupt Flag: PxIFG.0; Interrupt Priority: Highest); 4=IFG1 (Interrupt Source: Port x.1 interrupt; Interrupt Flag: PxIFG.1); 6=IFG2 (Interrupt Source: Port x.2 interrupt; Interrupt Flag: PxIFG.2); 8=IFG3 (Interrupt Source: Port x.3 interrupt; Interrupt Flag: PxIFG.3); 10=IFG4 (Interrupt Source: Port x.4 interrupt; Interrupt Flag: PxIFG.4); 12=IFG5 (Interrupt Source: Port x.5 interrupt; Interrupt Flag: PxIFG.5); 14=IFG6 (Interrupt Source: Port x.6 interrupt; Interrupt Flag: PxIFG.6); 16=IFG7 (Interrupt Source: Port x.7 interrupt; Interrupt Flag: PxIFG.7; Interrupt Priority: Lowest)

## P5
Base 0x00000240
0x00 P5IN 8-bit — Port 5 Input
0x02 P5OUT 8-bit — Port 5 Output
0x04 P5DIR 8-bit — Port 5 Direction
0x06 P5REN 8-bit — Port 5 Resistor Enable
0x0A P5SEL0 8-bit — Port 5 Select 0
0x0C P5SEL1 8-bit — Port 5 Select 1
0x0E P5IV — Port 5 Interrupt Vector Register
  [15:0] P5IV ro — Port 5 interrupt vector value
    0=NONE (No interrupt pending); 2=IFG0 (Interrupt Source: Port x.0 interrupt; Interrupt Flag: PxIFG.0; Interrupt Priority: Highest); 4=IFG1 (Interrupt Source: Port x.1 interrupt; Interrupt Flag: PxIFG.1); 6=IFG2 (Interrupt Source: Port x.2 interrupt; Interrupt Flag: PxIFG.2); 8=IFG3 (Interrupt Source: Port x.3 interrupt; Interrupt Flag: PxIFG.3); 10=IFG4 (Interrupt Source: Port x.4 interrupt; Interrupt Flag: PxIFG.4); 12=IFG5 (Interrupt Source: Port x.5 interrupt; Interrupt Flag: PxIFG.5); 14=IFG6 (Interrupt Source: Port x.6 interrupt; Interrupt Flag: PxIFG.6); 16=IFG7 (Interrupt Source: Port x.7 interrupt; Interrupt Flag: PxIFG.7; Interrupt Priority: Lowest)
0x16 P5SELC 8-bit — Port 5 Complement Select
0x18 P5IES 8-bit — Port 5 Interrupt Edge Select
0x1A P5IE 8-bit — Port 5 Interrupt Enable
0x1C P5IFG 8-bit — Port 5 Interrupt Flag

## P6
Base 0x00000240
0x01 P6IN 8-bit — Port 6 Input
0x03 P6OUT 8-bit — Port 6 Output
0x05 P6DIR 8-bit — Port 6 Direction
0x07 P6REN 8-bit — Port 6 Resistor Enable
0x0B P6SEL0 8-bit — Port 6 Select 0
0x0D P6SEL1 8-bit — Port 6 Select 1
0x17 P6SELC 8-bit — Port 6 Complement Select
0x19 P6IES 8-bit — Port 6 Interrupt Edge Select
0x1B P6IE 8-bit — Port 6 Interrupt Enable
0x1D P6IFG 8-bit — Port 6 Interrupt Flag
0x1E P6IV — Port 6 Interrupt Vector Register
  [15:0] P6IV ro — Port 6 interrupt vector value
    0=NONE (No interrupt pending); 2=IFG0 (Interrupt Source: Port x.0 interrupt; Interrupt Flag: PxIFG.0; Interrupt Priority: Highest); 4=IFG1 (Interrupt Source: Port x.1 interrupt; Interrupt Flag: PxIFG.1); 6=IFG2 (Interrupt Source: Port x.2 interrupt; Interrupt Flag: PxIFG.2); 8=IFG3 (Interrupt Source: Port x.3 interrupt; Interrupt Flag: PxIFG.3); 10=IFG4 (Interrupt Source: Port x.4 interrupt; Interrupt Flag: PxIFG.4); 12=IFG5 (Interrupt Source: Port x.5 interrupt; Interrupt Flag: PxIFG.5); 14=IFG6 (Interrupt Source: Port x.6 interrupt; Interrupt Flag: PxIFG.6); 16=IFG7 (Interrupt Source: Port x.7 interrupt; Interrupt Flag: PxIFG.7; Interrupt Priority: Lowest)
