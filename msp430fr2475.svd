# MSP430FR2475 register map
Vendor: msp430gen; File version: v0.4.0-28-gb0087ce-dirty
Registers are 16-bit, read-write, reset 0x0 unless marked. A register's access mark holds for its fields unless they carry their own. Offsets are from the block's base; lines under a group give offsets from that group; [hi:lo] are bit positions; {n}, {i} and the like mark numbered series; 'fields as' and 'values as' point back to an identical list; <NAME> marks a mode.

## Memory map
0x00000100 SFR
0x00000120 PMM
0x00000140 SYS
0x00000180 CS
0x000001A0 FRCTL
0x000001C0 CRC
0x000001CC WDT_A
0x00000200 P1
0x00000200 P2
0x00000220 P3
0x00000220 P4
0x00000240 P5
0x00000240 P6
0x00000300 RTC
0x00000380 TA0
0x000003C0 TA1
0x00000400 TA2
0x00000440 TA3
0x00000480 TB0
0x000004C0 MPY32
0x00000500 E_USCI_A0
0x00000520 E_USCI_A1
0x00000540 E_USCI_B0
0x00000580 E_USCI_B1
0x00000660 BAKMEM
0x00000700 ADC
0x000008E0 E_COMP0
0x00001A00 TLV size 0x100 — Device descriptors (TLV)
0x0000FF80 _INTERRUPTS

## Interrupts
37 ECOMP0 (_INTERRUPTS) — 0xFFCA
38 PORT6 (_INTERRUPTS) — 0xFFCC
39 PORT5 (_INTERRUPTS) — 0xFFCE
40 PORT4 (_INTERRUPTS) — 0xFFD0
41 PORT3 (_INTERRUPTS) — 0xFFD2
42 PORT2 (_INTERRUPTS) — 0xFFD4
43 PORT1 (_INTERRUPTS) — 0xFFD6
44 ADC (_INTERRUPTS) — 0xFFD8
45 EUSCI_B1 (_INTERRUPTS) — 0xFFDA
46 EUSCI_B0 (_INTERRUPTS) — 0xFFDC
47 EUSCI_A1 (_INTERRUPTS) — 0xFFDE
48 EUSCI_A0 (_INTERRUPTS) — 0xFFE0
49 WDT (_INTERRUPTS) — 0xFFE2
50 RTC (_INTERRUPTS) — 0xFFE4
51 TIMER0_B1 (_INTERRUPTS) — 0xFFE6
52 TIMER0_B0 (_INTERRUPTS) — 0xFFE8
53 TIMER3_A1 (_INTERRUPTS) — 0xFFEA
54 TIMER3_A0 (_INTERRUPTS) — 0xFFEC
55 TIMER2_A1 (_INTERRUPTS) — 0xFFEE
56 TIMER2_A0 (_INTERRUPTS) — 0xFFF0
57 TIMER1_A1 (_INTERRUPTS) — 0xFFF2
58 TIMER1_A0 (_INTERRUPTS) — 0xFFF4
59 TIMER0_A1 (_INTERRUPTS) — 0xFFF6
60 TIMER0_A0 (_INTERRUPTS) — 0xFFF8
61 UNMI (_INTERRUPTS) — 0xFFFA
62 SYSNMI (_INTERRUPTS) — 0xFFFC

## P1
Base 0x00000200
0x00 P1IN 8-bit — Port 1 Input
0x02 P1OUT 8-bit — Port 1 Output
0x04 P1DIR 8-bit — Port 1 Direction
0x06 P1REN 8-bit — Port 1 Resistor Enable
0x0A P1SEL0 8-bit — Port 1 Select 0
0x0C P1SEL1 8-bit — Port 1 Select 1
0x0E P1IV — Port 1 Interrupt Vector Register
  [15:0] P1IV ro — Port 1 interrupt vector value
    0=NONE (No interrupt pending); 2=IFG0 (Interrupt Source: Port x.0 interrupt; Interrupt Flag: PxIFG.0; Interrupt Priority: Highest); 4=IFG1 (Interrupt Source: Port x.1 interrupt; Interrupt Flag: PxIFG.1); 6=IFG2 (Interrupt Source: Port x.2 interrupt; Interrupt Flag: PxIFG.2); 8=IFG3 (Interrupt Source: Port x.3 interrupt; Interrupt Flag: PxIFG.3); 10=IFG4 (Interrupt Source: Port x.4 interrupt; Interrupt Flag: PxIFG.4); 12=IFG5 (Interrupt Source: Port x.5 interrupt; Interrupt Flag: PxIFG.5); 14=IFG6 (Interrupt Source: Port x.6 interrupt; Interrupt Flag: PxIFG.6); 16=IFG7 (Interrupt Source: Port x.7 interrupt; Interrupt Flag: PxIFG.7; Interrupt Priority: Lowest)
0x16 P1SELC 8-bit — Port 1 Complement Select
0x18 P1IES 8-bit — Port 1 Interrupt Edge Select
0x1A P1IE 8-bit — Port 1 Interrupt Enable
0x1C P1IFG 8-bit — Port 1 Interrupt Flag

## P2
Base 0x00000200
0x01 P2IN 8-bit — Port 2 Input
0x03 P2OUT 8-bit — Port 2 Output
0x05 P2DIR 8-bit — Port 2 Direction
0x07 P2REN 8-bit — Port 2 Resistor Enable
0x0B P2SEL0 8-bit — Port 2 Select 0
0x0D P2SEL1 8-bit — Port 2 Select 1
0x17 P2SELC 8-bit — Port 2 Complement Select
0x19 P2IES 8-bit — Port 2 Interrupt Edge Select
0x1B P2IE 8-bit — Port 2 Interrupt Enable
0x1D P2IFG 8-bit — Port 2 Interrupt Flag
0x1E P2IV — Port 2 Interrupt Vector Register
  [15:0] P2IV ro — Port 2 interrupt vector value
    0=NONE (No interrupt pending); 2=IFG0 (Interrupt Source: Port x.0 interrupt; Interrupt Flag: PxIFG.0; Interrupt Priority: Highest); 4=IFG1 (Interrupt Source: Port x.1 interrupt; Interrupt Flag: PxIFG.1); 6=IFG2 (Interrupt Source: Port x.2 interrupt; Interrupt Flag: PxIFG.2); 8=IFG3 (Interrupt Source: Port x.3 interrupt; Interrupt Flag: PxIFG.3); 10=IFG4 (Interrupt Source: Port x.4 interrupt; Interrupt Flag: PxIFG.4); 12=IFG5 (Interrupt Source: Port x.5 interrupt; Interrupt Flag: PxIFG.5); 14=IFG6 (Interrupt Source: Port x.6 interrupt; Interrupt Flag: PxIFG.6); 16=IFG7 (Interrupt Source: Port x.7 interrupt; Interrupt Flag: PxIFG.7; Interrupt Priority: Lowest)
